#include "Common.h"
#include "delay.h"
#include "TSSD1306.h"
#include "i2c_handler.h"
#include "stdio.h"

uint8_t OLED_WIDTH = 128;
uint8_t OLED_HEIGHT=64;
uint8_t OLED_ADD=0x78;
uint8_t OLED_Col_Offset=0;
uint8_t SSD1306_COMPINMODE=0x02;
uint8_t OLED_currLine=0,OLED_currCol=0;
uint8_t ActiveFont = 1,ACTIVE_FONT_WIDTH=3,mPlex=0x3F;


//power up Sequence
#define SSD1306_SETLOWCOLUMN 0x00
/** Set Higher Column Start Address for Page Addressing Mode. */
#define SSD1306_SETHIGHCOLUMN 0x10
/** Set Memory Addressing Mode. */
#define SSD1306_MEMORYMODE 0x20
/** Set display RAM display start line register from 0 - 63. */
#define SSD1306_SETSTARTLINE 0x40
/** Set Display Contrast to one of 256 steps. */
#define SSD1306_SETCONTRAST 0x81
/** Enable or disable charge pump.  Follow with 0X14 enable, 0X10 disable. */
#define SSD1306_CHARGEPUMP 0x8D
/** Set Segment Re-map between data column and the segment driver. */
#define SSD1306_SEGREMAP 0xA0
/** Resume display from GRAM content. */
#define SSD1306_DISPLAYALLON_RESUME 0xA4
/** Force display on regardless of GRAM content. */
#define SSD1306_DISPLAYALLON 0xA5
/** Set Normal Display. */
#define SSD1306_NORMALDISPLAY 0xA6
/** Set Inverse Display. */
#define SSD1306_INVERTDISPLAY 0xA7
/** Set Multiplex Ratio from 16 to 63. */
#define SSD1306_SETMULTIPLEX 0xA8
/** Set Display off. */
#define SSD1306_DISPLAYOFF 0xAE
/** Set Display on. */
#define SSD1306_DISPLAYON 0xAF
/**Set GDDRAM Page Start Address. */
#define SSD1306_SETSTARTPAGE 0XB0
/** Set COM output scan direction normal. */
#define SSD1306_COMSCANINC 0xC0
/** Set COM output scan direction reversed. */
#define SSD1306_COMSCANDEC 0xC8
/** Set Display Offset. */
#define SSD1306_SETDISPLAYOFFSET 0xD3
/** Sets COM signals pin configuration to match the OLED panel layout. */
#define SSD1306_SETCOMPINS 0xDA
/** This command adjusts the VCOMH regulator output. */
#define SSD1306_SETVCOMDETECT 0xDB
/** Set Display Clock Divide Ratio/ Oscillator Frequency. */
#define SSD1306_SETDISPLAYCLOCKDIV 0xD5
/** Set Pre-charge Period */
#define SSD1306_SETPRECHARGE 0xD9
/** No Operation Command. */
#define SSD1306_NOP 0XE3





#define CMDS	0x00
#define CMD		0x80
#define DATS	0x40
#define DAT		0xC0
#define ACTIVE_FONT_SPACING 1


const uint8_t code font[2][475] =
{
	{
	0x00, 0x00, 0x00, 0x00, 0x00, // SPACE
	0x00, 0x00, 0x5F, 0x00, 0x00, // !
	0x00, 0x03, 0x00, 0x03, 0x00, // "
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	0x02, 0x01, 0x02, 0x04, 0x02, // ~
}
,{
	0x00,0x00,0x00, //
	0x00,0x5c,0x00, // !
	0x0C,0x00,0x0C, // "
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	0x08,0x0C,0x04, //

}
};

void OLED_Settings(uint8_t oAdd,uint8_t width, uint8_t height)
{
	OLED_WIDTH = width;
	OLED_HEIGHT = height;
	OLED_ADD=oAdd;
	if(OLED_HEIGHT > 32)	SSD1306_COMPINMODE = 0x12;
	else	SSD1306_COMPINMODE = 0x02;
	if(OLED_HEIGHT == 32)	mPlex = 0x1F;
	else if(OLED_HEIGHT == 48)
	{
		mPlex = 0x2F;
		OLED_Col_Offset = 32;
	}
	else mPlex = 0x3F;
}

void OLED_SetFont(uint8_t fnt)
{
	ActiveFont=fnt;
	if(fnt == 0)
		ACTIVE_FONT_WIDTH = 5;
	else
		ACTIVE_FONT_WIDTH = 3;
}
void OLED_Init()
{
	i2c_init();
	i2c_start(OLED_ADD);
	i2c_write(CMDS);
	i2c_write(SSD1306_DISPLAYOFF);
	i2c_write(SSD1306_SETDISPLAYCLOCKDIV);
	i2c_write(0x80);
	
	i2c_write(SSD1306_SETMULTIPLEX);
	i2c_write(mPlex);
	
	i2c_write(SSD1306_SETDISPLAYOFFSET | 0x00);
	
	i2c_write(SSD1306_SETSTARTLINE | 0x00);
	
	i2c_write(SSD1306_CHARGEPUMP);
	i2c_write(0x14);
	
	i2c_write(0x20);
	i2c_write(0x02);
	
	i2c_write(SSD1306_SEGREMAP | 0x01);
	
	i2c_write(SSD1306_COMSCANDEC);
	
	i2c_write(SSD1306_SETCOMPINS);
	i2c_write(SSD1306_COMPINMODE);		//Set to 0x12 if height is bigger than 32
	
	i2c_write(SSD1306_SETCONTRAST);
	i2c_write(0x80);
	
	i2c_write(SSD1306_SETPRECHARGE);
	i2c_write(0xF1);
	
	i2c_write(SSD1306_SETVCOMDETECT);
	i2c_write(0x40);
	
	i2c_write(0xA6);
	i2c_write(0xA4);
	
	i2c_write(0x21);
	i2c_write(0x0);
	i2c_write(OLED_WIDTH-1);
	
	i2c_write(0x22);
	i2c_write(0);
	i2c_write((OLED_HEIGHT/8)-1);
	
	i2c_write(0xAF);
	i2c_stop();
//	OLED_Clear();
//	OLED_Write("With many thanx to :");
//	Timer3_Delay100ms(6);
//	OLED_SetCursor(2,8);
//	OLED_SetFont(0);
//	OLED_Write("Aftabrayaneh Staff");
//	Timer3_Delay100ms(19);
//	OLED_Clear();
//	OLED_SetFont(1);
//	OLED_Write("Written By :");
//	OLED_SetFont(0);
//	OLED_SetCursor(1,8);
//	OLED_Write("Tirdad Sadri Nejad");
//	OLED_SetCursor(3,0);
//	OLED_Write("Tirdad_ms@hotmail.com");
//	Timer3_Delay100ms(30);
}


void OLED_SetCursor(uint8_t line,uint8_t column)
{
	i2c_start(OLED_ADD);
	i2c_write(CMDS);
	
	i2c_write(0x21);
	i2c_write(column%OLED_WIDTH);
	i2c_write(OLED_WIDTH-1);
	
	i2c_write(0x22);
	i2c_write(line%(OLED_HEIGHT/8));
	i2c_write((OLED_HEIGHT/8)-1);
	i2c_stop();
	OLED_currLine = line;
	OLED_currCol	 = column;
}

void OLED_ClearLine(uint8_t line)
{
	uint8_t i;
	OLED_SetCursor(line,0);
	i2c_start(OLED_ADD);
	i2c_write(DATS);
	for (i=0; i<OLED_WIDTH;i++)
	{
		i2c_write(0x00);
	}
	i2c_stop();
	OLED_SetCursor(line,0);
}


void OLED_ClearField(uint8_t line, uint8_t bgn, uint8_t end)
{
	uint8_t i;
	OLED_SetCursor(line,bgn);
	i2c_start(OLED_ADD);
	i2c_write(DATS);
	for (i=0;i<end;i++)
	{
		i2c_write(0x00);
	}
	i2c_stop();
	OLED_SetCursor(line,bgn);
}

void OLED_Clear()
{
	uint8_t i,j;
	for (j=0; j<OLED_HEIGHT/8;j++)
	{
		OLED_SetCursor(j,0);
		i2c_start(OLED_ADD);
		i2c_write(DATS);
		for (i=0;i<OLED_WIDTH;i++)	i2c_write(0x00);
		i2c_stop();
	}
	OLED_SetCursor(0,0);
}

void OLED_WriteChar(uint8_t oled_char)
{
	uint8_t i;
	oled_char = oled_char-32;
	i2c_start(OLED_ADD);
	i2c_write(DATS);
	for (i=0; i<ACTIVE_FONT_WIDTH;i++)
	{
		i2c_write((font[ActiveFont][(oled_char*ACTIVE_FONT_WIDTH)+i]));
	}
	for(i=0;i<ACTIVE_FONT_SPACING;i++)
	{
		i2c_write(0x00);
	}
	i2c_stop();
	OLED_currCol += ACTIVE_FONT_WIDTH + ACTIVE_FONT_SPACING;
	if (OLED_currCol > OLED_WIDTH-(ACTIVE_FONT_SPACING + ACTIVE_FONT_WIDTH))
	{
		if(OLED_currLine < (OLED_HEIGHT/8)-1) 
		{
			OLED_SetCursor(OLED_currLine+1,0);
		}
		else 
		{
			OLED_Clear();
		}
	}
}

void OLED_Write(char const* str)
{
	uint8_t i=0;
	
	while(str[i] != '\0')
	{
		OLED_WriteChar(str[i]);
		i++;
	}
}
void OLED_WriteINT(int num)
{
	char buff[12];
	sprintf(buff,"%i",num);
	OLED_Write(buff);
}
void OLED_SetContrast(uint8_t cntr)
{
	i2c_start(OLED_ADD)	;
	i2c_write(CMDS);
	i2c_write(SSD1306_SETCONTRAST);
	i2c_write(cntr);
	i2c_stop();
}